## package/python-amqp/Config.in
```kconfig
config BR2_PACKAGE_PYTHON_AMQP
	bool "python-amqp"
	help
          Low-level AMQP client for Python (fork of amqplib).
```

## package/python-automat/Config.in
```kconfig
config BR2_PACKAGE_PYTHON_AUTOMAT
	bool "python-automat"
	select BR2_PACKAGE_PYTHON_SIX
	select BR2_PACKAGE_PYTHON_ATTRS
	help
	  Self-service finite-state machines for the programmer on the go.
```

## package/python-billiard/Config.in
```kconfig
config BR2_PACKAGE_PYTHON_BILLIARD
	bool "python-billiard"
	help
          Python multiprocessing fork with improvements and bugfixes.
```

## package/python-celery/Config.in
```kconfig
config BR2_PACKAGE_PYTHON_CELERY
	bool "python-celery"
	select BR2_PACKAGE_PYTHON_VINE
	select BR2_PACKAGE_PYTHON_KOMBU
        select BR2_PACKAGE_PYTHON_BILLIARD
	select BR2_PACKAGE_PYTHON_PYTZ
	help
          Distributed Task Queue.
```

## package/python-google-api-python-client/Config.in
```kconfig
config BR2_PACKAGE_PYTHON_GOOGLE_API_PYTHON_CLIENT
	bool "python-google-api-python-client"
	select BR2_PACKAGE_PYTHON_SIX
	select BR2_PACKAGE_PYTHON_HTTPLIB2
	select BR2_PACKAGE_PYTHON_OAUTH2CLIENT
	select BR2_PACKAGE_PYTHON_URITEMPLATE
	help
	  The Google API Client for Python is a client library for accessing the Plus, Moderator, and many other Google APIs.
```

## package/python-kombu/Config.in
```kconfig
config BR2_PACKAGE_PYTHON_KOMBU
	bool "python-kombu"
	select BR2_PACKAGE_PYTHON_LIBRABBITMQ
	help
          Messaging library for Python.
```

## package/python-librabbitmq/Config.in
```kconfig
config BR2_PACKAGE_PYTHON_LIBRABBITMQ
	bool "python-librabbitmq"
	select BR2_PACKAGE_RABBITMQ_C
	select BR2_PACKAGE_PYTHON_AMQP
	help
          Python bindings to the RabbitMQ C-library rabbitmq-c.
          Supported by Kombu and Celery.
```

## package/python-librtmp/Config.in
```kconfig
config BR2_PACKAGE_PYTHON_LIBRTMP
	bool "python-librtmp"
	select BR2_PACKAGE_RTMPDUMP
	select BR2_PACKAGE_PYTHON_CFFI
	select BR2_PACKAGE_PYTHON_SINGLEDISPATCH
	help
	  Python bindings for librtmp, built with cffi
```

## package/python-oauth2client/Config.in
```kconfig
config BR2_PACKAGE_PYTHON_OAUTH2CLIENT
	bool "python-oauth2client"
	select BR2_PACKAGE_PYTHON_SIX
	select BR2_PACKAGE_PYTHON_RSA
	select BR2_PACKAGE_PYTHON_HTTPLIB2
	select BR2_PACKAGE_PYTHON_PYASN
	select BR2_PACKAGE_PYTHON_PYASN_MODULES
	help
	  oauth2client is a client library for OAuth 2.0
```

## package/python-uritemplate/Config.in
```kconfig
config BR2_PACKAGE_PYTHON_URITEMPLATE
	bool "python-uritemplate"
	help
	  Simple python library to deal with URI Templates.
```

## package/python-vine/Config.in
```kconfig
config BR2_PACKAGE_PYTHON_VINE
	bool "python-vine"
	help
          Promises, promises, promises.
```

## package/python-xlib/Config.in
```kconfig
config BR2_PACKAGE_PYTHON_XLIB
	bool "python-xlib"
	depends on BR2_PACKAGE_PYTHON
	select BR2_PACKAGE_XLIB_LIBX11
	select BR2_PACKAGE_PYTHON_SIX
	help
	  Python X Library
```
